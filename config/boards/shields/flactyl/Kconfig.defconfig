## config/boards/shields/flactyl/Kconfig.defconfig
```kconfig
if SHIELD_FLACTYL_LEFT

config ZMK_KEYBOARD_NAME
	default "Flactyl"

config ZMK_SPLIT_ROLE_CENTRAL
	default y
endif

if SHIELD_FLACTYL_LEFT || SHIELD_FLACTYL_RIGHT

config ZMK_SPLIT
	default y

endif
```

## config/boards/shields/flactyl/Kconfig.shield
```kconfig
# Copyright (c) 2022 yangit
# SPDX-License-Identifier: MIT

config SHIELD_FLACTYL_LEFT
	def_bool $(shields_list_contains,flactyl_left)

config SHIELD_FLACTYL_RIGHT
	def_bool $(shields_list_contains,flactyl_right)
```
